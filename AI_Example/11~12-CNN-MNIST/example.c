/*

CNN-MNIST测试

训练提前在TensorFlow上完成

*/
//定义OS
OSlwCoreSTU myos;

#define CNN_MODE 1

//闪灯任务 确认OS在运行
OSlwTaskSTU mytask;
void Mytask(OSlwTaskSTU *_pta)
{
	static OSlwTaskSTU *pta;
	pta=_pta;
	OSlwJiJi(_pta);
	for(;;)	
	{		
		HAL_GPIO_TogglePin(LED1_GPIO_Port, LED1_Pin);
		OSlwSleepSec(pta,1,0);
	}
	OSlwWeiJi(_pta);

}

//StrDbg任务 用于测试
OSlwTaskSTU task_sd;
lw_u8 rx_buf[500];
void SDtask(OSlwTaskSTU *_pta)
{
	static OSlwTaskSTU *pta;
	static lw_u8 *pstr;
	
	pta=_pta;
	OSlwJiJi(_pta);
	
	pta->TaskGroupFlag.AimStatus.all=0xff;
	for(;;)	
	{
		OSlwWaitFlag(pta);
		pstr=myos.StrDbgFun(&myos,rx_buf);
		HAL_UART_Transmit(&huart1,pstr,strlen(pstr),1000); 
		LwClearFlag(pta,0);
	}
	OSlwWeiJi(_pta);

}

//导入权重
#include "MNIST_CNN.h"

OSLW_MEM_SIMPLE_DEF(mem, 32, 300)

//交替使用层 节约RAM空间
ParaType l1[12*12*32], l2[24*24*32], l3[24*24*32];

OSlwToolBPnnSTU mynn;

//用来测试的xin
ParaType xin[28][28]={ 0.0, 0.0, 0.0, 0.0, 0.0, 0.0, 0.0, 0.0, 0.0, 0.0, 0.0, 0.0, 0.0,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 0.0, 0.0 };

//输出
ParaType yout[10];

//strdbg输入
lw_u32 xin_c[28];
STR_DBG_DEF(xin_c,"image")

//测试用的函数
void CNNtestRun()
{
	int i ,j;
	lw_u8 outs[30];
	for(i=0;i<28;++i)
	{
		for(j=0;j<28;j++)
		{
			if(xin_c[i] & (1<<j))
			{
				xin[i][j]=0.5;
			}
			else
			{
				xin[i][j]=-0.5;
			}
		}
	}
	
	OSlwToolBPnnRun(&mynn,NULL);
	for(i=0;i<10;++i)
	{
		sprintf(outs,"%d:%f\n",i,yout[i]);
		HAL_UART_Transmit(&huart1,outs,strlen(outs),1000); 	
	}
	
	
}
STR_DBG_DEF(CNNtestRun,"CNN")


OSlwTaskSTU task_NN;

//采用手动追加方法
OSlwToolDListNodeSTU node1;
OSlwToolNNLayerFullConSTU *pfc[10];

void NNtask(OSlwTaskSTU *_pta)
{
	static OSlwTaskSTU *pta;
	static ParaType a= 0.1;
	static lw_u32 info[4];
	static int i, j;
	static lw_u8 str[50];
	static ParaType sum=0;	
	pta=_pta;
	OSlwJiJi(_pta);
	STR_DBG_INC(myos.StrDbg,xin_c,'l',28);
	STR_DBG_INC(myos.StrDbg,CNNtestRun,'F',0);
	
	OSLW_MEM_INIT(mem);
	OSlwToolBPnnInit(&mynn, 1);
	mynn.Train.Flag.NeedTrain = 1;
	
	//新建卷积层
	pfc[0]=(void *)OSlwToolNNLayerConvNew(
		(void *)xin, l2, 
		28, 28, 1, 
		5, 5, 32, 1, 
		'v', 
		1, 
		pmem, 
		info
	);
	pfc[0]->Weight.a = (void *)we1;
	pfc[0]->Bias.a = (void *)bi1;

	//新建RELU激活函数
	pfc[1] = (void *)OSlwToolNNLayerActFunNew(
		l2, l3, 
		info[3], 1, 
		pmem, 
		LwReLU, 0
	);

	//新建池化层 平均值池化
	pfc[2] = (void *)OSlwToolNNLayerPoolNew(
		l3, l1, 
		info[0], info[1], info[2], 
		2, 2, 
		OSlwToolNNPoolingMethod_Avg, 
		1, 
		pmem, 
		info
	);

	//新建卷积层
	pfc[3] = (void *)OSlwToolNNLayerConvNew(
		l1, l2,
		info[0], info[1], info[2],
		5, 5, 64, 1,
		'v',
		1,
		pmem,
		info
	);
	pfc[3]->Weight.a = (void *)we2;
	pfc[3]->Bias.a = (void *)bi2;

	//新建RELU激活函数
	pfc[4] = (void *)OSlwToolNNLayerActFunNew(
		l2, l3,
		info[3], 1,
		pmem,
		LwReLU, 0
	);

	//新建池化层
	pfc[5] = (void *)OSlwToolNNLayerPoolNew(
		l3, l1,
		info[0], info[1], info[2],
		2, 2,
		OSlwToolNNPoolingMethod_Avg,
		1,
		pmem,
		info
	);

	//新建全连接层
	pfc[6] = (void *)OSlwToolNNLayerFullConNew(l1, l2, info[3], 256, 1, pmem);
	//新建RELU激活函数
	pfc[7] = (void *)OSlwToolNNLayerActFunNew(
		l2, l3,
		256, 1,
		pmem,
		LwReLU, 0
	);
	pfc[6]->Weight.a = (void *)we3;
	pfc[6]->Bias.a = (void *)bi3;

	//新建全连接层
	pfc[8] = (void *)OSlwToolNNLayerFullConNew(l3, l1, 256, 10, 1, pmem);
	//新建softmax激活函数 作为分类输出
	pfc[9] = (void *)OSlwToolNNLayerActFunNew(
		l1, yout,
		10, 10,
		pmem,
		LwSoftMax, 0
	);
	pfc[8]->Weight.a = (void *)we4;
	pfc[8]->Bias.a = (void *)bi4;

	//追加10层到神经网络
	OSlwToolBPnnLayerAppend(&mynn, &node1, 10, pfc);
	
	//初始化参数
	OSlwToolBPnnAllDataInit(&mynn, pmem);

	//运行一次 测试一下
	OSlwToolBPnnRun(&mynn,NULL);	

	
	while(1)
	{
		pta->TaskFrozenFlag=1;
		OSlwSleepSec(pta,10,0);
	}
	
	OSlwWeiJi(_pta);

}




/*
int main(void)
{
	//。。。各种初始化。。。
	
	OSlwCoreInitial(&myos);
	OSlwTaskInit(&mytask,3,"T1",0,NULL,Mytask);
	myos.TaskAppendFun(&myos,&mytask);
	
	OSlwTaskInit(&task_NN, 4, "NN", 0, NULL, NNtask);
	myos.TaskAppendFun(&myos, &task_NN);

	OSlwTaskInit(&task_sd,5,"SD",0,NULL,SDtask);
	myos.TaskAppendFun(&myos,&task_sd);

	
	//。。。开启OS定时器。。。
	
	myos.StartFun(&myos);
	
	return;
}

*/